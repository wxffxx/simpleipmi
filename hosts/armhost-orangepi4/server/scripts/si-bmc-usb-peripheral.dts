// SI BMC — Device Tree Overlay
// Forces DWC3 USB controller into peripheral (device) mode
// for USB HID gadget (keyboard + mouse emulation)
//
// Target: Orange Pi CM4 (RK3566) — dwc3@fcc00000
//
// Compile:
//   dtc -@ -I dts -O dtb -o /boot/dtbo/si-bmc-usb-peripheral.dtbo si-bmc-usb-peripheral.dts
//
// Apply: Add to /boot/orangepiEnv.txt:
//   overlays=si-bmc-usb-peripheral

/dts-v1/;
/plugin/;

/ {
    compatible = "rockchip,rk3566";

    fragment@0 {
        target-path = "/usbdrd/dwc3@fcc00000";

        __overlay__ {
            dr_mode = "peripheral";
            /delete-property/ extcon;
        };
    };
};
